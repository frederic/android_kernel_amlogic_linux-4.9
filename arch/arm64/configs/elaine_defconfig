## arch/arm64/configs/elaine_defconfig
```kconfig
# additions from elaine-bx_defconfig compared to g12a_defconfig
CONFIG_AMLOGIC_DRM=y
CONFIG_AMLOGIC_SND_SOC_TAS575X=y
CONFIG_AMLOGIC_SND_SPLIT_MODE_MMAP=y
CONFIG_ANDROID_LOGGER=y
CONFIG_AUTOFS4_FS=y
CONFIG_BACKLIGHT_LP855X=y
CONFIG_BINFMT_MISC=y
CONFIG_BPF_JIT_ALWAYS_ON=y
CONFIG_BPF_JIT=y
CONFIG_BT_BNEP_MC_FILTER=y
CONFIG_BT_BNEP_PROTO_FILTER=y
CONFIG_BT_BNEP=y
CONFIG_BT_HCIUART_H4=y
CONFIG_BT_HCIUART=y
CONFIG_BT_HIDP=y
CONFIG_BT_RFCOMM_TTY=y
CONFIG_BT_RFCOMM=y
CONFIG_CFG80211_INTERNAL_REGDB=y
CONFIG_CFG80211_WEXT=y
CONFIG_CFS_BANDWIDTH=y
CONFIG_CGROUP_DEBUG=y
CONFIG_CMA_AREAS=15
CONFIG_CMA_DEBUGFS=y
CONFIG_CONNECTOR=y
CONFIG_CRC_ITU_T=y
CONFIG_CRYPTO_ANSI_CPRNG=y
CONFIG_CRYPTO_CRCT10DIF=y
CONFIG_CRYPTO_CRYPTD=y
CONFIG_CRYPTO_XTS=y
CONFIG_DEVFREQ_GOV_PERFORMANCE=y
CONFIG_DEVFREQ_GOV_POWERSAVE=y
CONFIG_DEVFREQ_GOV_SIMPLE_ONDEMAND=y
CONFIG_DEVFREQ_GOV_USERSPACE=y
CONFIG_DNS_RESOLVER=y
CONFIG_DRM_MESON_PANEL=y
CONFIG_DRM_MESON_USE_ION=y
CONFIG_DRM_MESON_VPU=y
CONFIG_DRM_MESON=y
CONFIG_DRM=y
CONFIG_EEPROM_AT24=y
CONFIG_EXT4_FS_SECURITY=y
CONFIG_EXT4_FS=y
CONFIG_FANOTIFY=y
CONFIG_FRAME_WARN=4096
CONFIG_GPIO_PCA953X=y
CONFIG_HZ_1000=y
CONFIG_I2C_HID=y
CONFIG_ICPLUS_PHY=y
CONFIG_INPUT_FF_MEMLESS=y
CONFIG_INPUT_POLLDEV=y
CONFIG_INPUT_TOUCHSCREEN=y
CONFIG_IP6_NF_NAT=y
CONFIG_IP6_NF_TARGET_MASQUERADE=y
CONFIG_IP6_NF_TARGET_NPT=y
CONFIG_IP_NF_MATCH_AH=y
CONFIG_IPV6_TUNNEL=y
CONFIG_IRQ_TIME_ACCOUNTING=y
CONFIG_KEYS=y
CONFIG_KPROBES=y
CONFIG_L2TP_DEBUGFS=y
CONFIG_L2TP_ETH=y
CONFIG_L2TP_IP=y
CONFIG_L2TP_V3=y
CONFIG_LEDS_TRIGGER_BACKLIGHT=y
CONFIG_MAC80211=y
CONFIG_MFD_SYSCON=y
CONFIG_NET_ACT_BPF=y
CONFIG_NET_ACT_GACT=y
CONFIG_NET_ACT_MIRRED=y
CONFIG_NET_ACT_POLICE=y
CONFIG_NETFILTER_NETLINK_GLUE_CT=y
CONFIG_NETFILTER_NETLINK_LOG=y
CONFIG_NETFILTER_NETLINK_QUEUE=y
CONFIG_NETFILTER_XT_CONNMARK=y
CONFIG_NETFILTER_XT_MARK=y
CONFIG_NETFILTER_XT_MATCH_MULTIPORT=y
CONFIG_NETLABEL=y
CONFIG_NF_CONNTRACK_TIMEOUT=y
CONFIG_NF_CONNTRACK_TIMESTAMP=y
CONFIG_NF_CT_NETLINK_TIMEOUT=y
CONFIG_NF_TABLES=y
CONFIG_NFT_MASQ=y
CONFIG_OPTEE=y
CONFIG_PANIC_TIMEOUT=-1
CONFIG_PTP_1588_CLOCK=y
CONFIG_REGULATOR_GPIO=y
CONFIG_RESET_CONTROLLER=y
CONFIG_SCHED_STACK_END_CHECK=y
CONFIG_SECURITYFS=y
CONFIG_SECURITY_PATH=y
CONFIG_SENSORS_IIO_HWMON=y
CONFIG_SENSORS_INA2XX=y
CONFIG_SENSORS_LM75=y
CONFIG_SENSORS_NTC_THERMISTOR=y
CONFIG_SENSORS_SHTC1=y
CONFIG_SERIO_LIBPS2=y
CONFIG_SPI_DEBUG=y
CONFIG_SQUASHFS_DECOMP_MULTI=y
CONFIG_SQUASHFS_XATTR=y
CONFIG_SQUASHFS_XZ=y
CONFIG_SQUASHFS=y
CONFIG_STACK_TRACER=y
CONFIG_SYSVIPC=y
CONFIG_TCS3472=y
CONFIG_TEE=y
CONFIG_THERMAL_DEFAULT_GOV_POWER_ALLOCATOR=y
CONFIG_THERMAL_GOV_USER_SPACE=y
CONFIG_THERMAL_WRITABLE_TRIPS=y
CONFIG_USB_ACM=y
CONFIG_USB_ISP1301=y
CONFIG_USB_OHCI_HCD=y
CONFIG_USB_SERIAL_CONSOLE=y
CONFIG_USB_SERIAL_FTDI_SIO=y
CONFIG_USB_SERIAL_KEYSPAN=y
CONFIG_USB_USBNET=y
CONFIG_USB=y
CONFIG_VIRTIO_BLK=y
CONFIG_VIRTIO_MMIO=y
CONFIG_WQ_WATCHDOG=y
# additions from savedefconfig in kernel GPL release
CONFIG_NL80211_SKIP_PERM_CHECK=y
CONFIG_CFG80211_FAKE_REGDB=y
CONFIG_USE_VOL_UP_AND_DOWN_AS_FDR=y
CONFIG_AMLOGIC_VDAC=y
CONFIG_BCMDHD=m
CONFIG_BCMDHD_FW_PATH="/system/lib/firmware/fw_bcmdhd.bin"
CONFIG_BCMDHD_NVRAM_PATH="/system/lib/firmware/nvram.txt"
CONFIG_AMLOGIC_MEDIA_VENC_H264=y
CONFIG_FLASH_TS_MMC=y
CONFIG_TOUCHSCREEN_GOODIX_GTX8_TOOLS=y
CONFIG_SERIO_LIBPS2=y
CONFIG_SND_SOC_TAS5825M=y
CONFIG_AUGE_PDM_TDM_SRC_CLK_HIGH_RATE=y
CONFIG_USE_TCS3400=y
CONFIG_TCS3400_AUTO_ADJUST=y
```
